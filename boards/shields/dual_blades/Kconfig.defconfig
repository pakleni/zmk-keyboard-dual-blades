## boards/shields/dual_blades/Kconfig.defconfig
```kconfig
if SHIELD_DUAL_BLADES_LEFT

# Name must be less than 16 characters long!
config ZMK_KEYBOARD_NAME
    default "Dual Blades"

config ZMK_SPLIT_ROLE_CENTRAL
    default y

endif

if SHIELD_DUAL_BLADES_LEFT || SHIELD_DUAL_BLADES_RIGHT

config ZMK_SPLIT
    default y

endif
```

## boards/shields/dual_blades/Kconfig.shield
```kconfig
config SHIELD_DUAL_BLADES_LEFT
    def_bool $(shields_list_contains,dual_blades_left)

config SHIELD_DUAL_BLADES_RIGHT
    def_bool $(shields_list_contains,dual_blades_right)
```
